/ {
	chosen {
		zephyr,console = &usart2;
		zephyr,shell-uart = &usart2;
		zephyr,sram = &sram0;
		zephyr,flash = &flash0;
	};
};

&usart2 {
	pinctrl-0 = <&usart2_tx_pb3 &usart2_rx_pb4>;
	pinctrl-names = "default";
	current-speed = <115200>;
	status = "okay";
};